## config/boards/shields/kez/Kconfig.defconfig
```kconfig
# Copyright (c) 2020 The ZMK Contributors
# SPDX-License-Identifier: MIT

if SHIELD_KEZ

config ZMK_KEYBOARD_NAME
    default "kez"

endif
```
